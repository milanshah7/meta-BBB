## conf/distro/bbb-distro.conf
```bitbake
require conf/distro/poky.conf

DISTRO = "bbb-distro"
DISTRO_NAME = "bbb-distro"
DISTRO_VERSION = "1.0"
DISTRO_CODENAME = "apple"

# Set systemd as init manager
DISTRO_FEATURES += "systemd"
VIRTUAL_RUNTIME_init_manager = "systemd"

# remove sysvinit
DISTRO_FEATURES_BACKFILL_CONSIDERED = "sysvinit"
VIRTUAL_RUNTIME_initscripts = " "

PREFERRED_VERSION_virtual/kernel = "linux-yocto"
```

## conf/distro/bbb_distro.conf
```bitbake
DISTRO = "bbb-distro"
DISTRO_NAME = "bbb-distro"
DISTRO_VERSION = "1.0"
DISTRO_CODENAME = "apple"

# Set systemd as init manager
DISTRO_FEATURES += "systemd"
VIRTUAL_RUNTIME_init_manager = "systemd"

# remove sysvinit
DISTRO_FEATURES_BACKFILL_CONSIDERED = "sysvinit"
VIRTUAL_RUNTIME_initscripts = " "
```

## conf/machine/bbb.conf
```bitbake
#@TYPE: Machine
#@NAME: bbb machine
#@DESCRIPTION: Reference machine configuration for http://beagleboard.org/bone and http://beagleboard.org/black boards

MACHINE_EXTRA_RRECOMMENDS = "kernel-modules kernel-devicetree"

EXTRA_IMAGEDEPENDS += "u-boot"

DEFAULTTUNE ?= "cortexa8hf-neon"
include conf/machine/include/tune-cortexa8.inc

IMAGE_FSTYPES += "tar.bz2 wic wic.bmap"
WKS_FILE ?= "beaglebone-yocto.wks"
IMAGE_INSTALL_append = " kernel-devicetree kernel-image-zimage"
do_image_wic[depends] += "mtools-native:do_populate_sysroot dosfstools-native:do_populate_sysroot u-boot:do_deploy"

SERIAL_CONSOLES ?= "115200;ttyS0"
SERIAL_CONSOLES_CHECK = "${SERIAL_CONSOLES}"

PREFERRED_PROVIDER_virtual/kernel ?= "linux-stable"
PREFERRED_VERSION_linux-stable ?= "5.4"

PREFERRED_PROVIDER_virtual/bootloader ?= "u-boot"
PREFERRED_PROVIDER_u-boot = "u-boot-denx"
PREFERRED_VERSION_u-boot = "2020.10"

KERNEL_IMAGETYPE = "zImage"
KERNEL_DEVICETREE = "am335x-bone.dtb am335x-boneblack.dtb"
KERNEL_EXTRA_ARGS += "LOADADDR=${UBOOT_ENTRYPOINT}"

SPL_BINARY = "MLO"
UBOOT_SUFFIX = "img"
UBOOT_MACHINE = "am335x_evm_defconfig"
UBOOT_ENTRYPOINT = "0x80008000"
UBOOT_LOADADDRESS = "0x80008000"

IMAGE_BOOT_FILES ?= "u-boot.${UBOOT_SUFFIX} ${SPL_BINARY} ${KERNEL_IMAGETYPE} ${KERNEL_DEVICETREE}"
```
